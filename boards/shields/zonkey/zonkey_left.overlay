#include "zonkey.dtsi"

&xiao_i2c {
    status = "disabled";
};

&kscan0 {
    col-gpios
    = <&gpio0 9 GPIO_ACTIVE_HIGH>
    , <&gpio0 4 GPIO_ACTIVE_HIGH>
    , <&gpio0 10 GPIO_ACTIVE_HIGH>
    , <&gpio0 5 GPIO_ACTIVE_HIGH>
    , <&gpio1 11 GPIO_ACTIVE_HIGH>
    , <&gpio1 12 GPIO_ACTIVE_HIGH>
    ;
};

&glidepoint_listener {
    status = "okay";
};

left_encoder_bottom: left_encoder_bottom {
        compatible = "alps,ec11";
        a-gpios = <&xiao_d 10 (GPIO_ACTIVE_HIGH | GPIO_PULL_UP)>;
        b-gpios = <&xiao_d 9 (GPIO_ACTIVE_HIGH | GPIO_PULL_UP)>;
        steps = <12>;
        status = "okay";
    };

    left_encoder_side: left_encoder_side {
        compatible = "alps,ec11";
        a-gpios = <&xiao_d 8 (GPIO_ACTIVE_HIGH | GPIO_PULL_UP)>;
        b-gpios = <&xiao_d 7 (GPIO_ACTIVE_HIGH | GPIO_PULL_UP)>;
        steps = <24>;
        status = "okay";
    };

    sensors: sensors {
        compatible = "zmk,keymap-sensors";
        sensors = <&left_encoder_bottom &left_encoder_side>;
        triggers-per-rotation = <10>;
    };
};

