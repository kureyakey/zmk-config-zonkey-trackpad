## boards/shields/zonkey/Kconfig.defconfig
```kconfig
if SHIELD_ZONKEY_L || SHIELD_ZONKEY_R

config ZMK_KEYBOARD_NAME
    default "Zonkey"

endif
```

## config/boards/shields/zonkey/Kconfig.shield
```kconfig
config SHIELD_ZONKEY_L
    def_bool $(shields_list_contains,zonkey_L)

config SHIELD_ZONKEY_R
    def_bool $(shields_list_contains,zonkey_R)
    # 以下の2行を追加して、依存関係を強制的に解決します
    select I2C
    select PINNACLE
```

## config/west.yml
```yaml
manifest:
  remotes:
    - name: zmkfirmware
      url-base: https://github.com/zmkfirmware
    - name: kureyakey
      url-base: https://github.com/kureyakey
    - name: caksoylar  # <-- new entry
      url-base: https://github.com/caksoylar  
  projects:
    - name: zmk
      remote: zmkfirmware
      revision: v0.3
      import: app/west.yml
    - name: zmk-pmw3610-driver
      remote: kureyakey
      revision: v0.3
    - name: zmk-rgbled-widget
      remote: caksoylar
      revision: v0.3
  self:
    path: config
```
