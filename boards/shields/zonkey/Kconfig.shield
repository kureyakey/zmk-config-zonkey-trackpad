## boards/shields/zonkey/Kconfig.shield
```kconfig
config SHIELD_ZONKEY_LEFT
    def_bool $(shields_list_contains,zonkey_left)

config SHIELD_ZONKEY_RIGHT
    def_bool $(shields_list_contains,zonkey_right)
```
